## firmware/milkv-mars/bootchain/firmware.its
```
/dts-v1/;
/ {
    description = "Mars paired OpenSBI and U-Boot";
    #address-cells = <2>;
    images {
        firmware {
            data = /incbin/("fw_payload.bin");
            type = "firmware";
            arch = "riscv";
            os = "u-boot";
            load = <0 0x40000000>;
            entry = <0 0x40000000>;
            compression = "none";
            hash-1 { algo = "sha256"; };
        };
    };
    configurations {
        default = "config-1";
        config-1 { firmware = "firmware"; };
    };
};
```

## firmware/milkv-mars/bootchain/vibeos.its
```
/dts-v1/;
/ {
    description = "VibeOS Mars 4GB serial and SD bring-up";
    #address-cells = <2>;
    images {
        kernel {
            data = /incbin/("vibeos.bin");
            type = "kernel";
            arch = "riscv";
            // Selects the RISC-V a0=hart, a1=DTB handoff in bootm.
            os = "linux";
            compression = "none";
            load = <0 0x40200000>;
            entry = <0 0x40200000>;
            hash-1 { algo = "sha256"; };
        };
        fdt {
            data = /incbin/("mars.dtb");
            type = "flat_dt";
            arch = "riscv";
            compression = "none";
            hash-1 { algo = "sha256"; };
        };
    };
    configurations {
        default = "mars-4gb";
        mars-4gb { kernel = "kernel"; fdt = "fdt"; };
    };
};
```

## scripts/milkv-duo.its
```
/dts-v1/;

/ {
	description = "VibeOS for Milk-V Duo";
	#address-cells = <2>;

	images {
		kernel {
			description = "VibeOS kernel";
			data = /incbin/("vibeos-milkv-duo.bin");
			type = "kernel";
			arch = "riscv";
			os = "linux";
			compression = "none";
			load = <0x00000000 0x80200000>;
			entry = <0x00000000 0x80200000>;

			hash {
				algo = "crc32";
			};
		};

		fdt {
			description = "Milk-V Duo CV1800B device tree";
			data = /incbin/("cv1800b_milkv_duo_sd.dtb");
			type = "flat_dt";
			arch = "riscv";
			compression = "none";

			hash {
				algo = "crc32";
			};
		};
	};

	configurations {
		default = "config-cv1800b_milkv_duo_sd";

		config-cv1800b_milkv_duo_sd {
			description = "VibeOS Milk-V Duo boot";
			kernel = "kernel";
			fdt = "fdt";
		};
	};
};
```
